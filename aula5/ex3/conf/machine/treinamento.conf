## aula5/ex3/conf/machine/treinamento.conf
```bitbake
require conf/machine/qemux86-64.conf

KMACHINE = "qemux86-64"

PREFERRED_PROVIDER_virtual/kernel = "linux-yocto"
PREFERRED_VERSION_linux-yocto ?= "6.6%"


MACHINE_FEATURES += "wifi bluetooth screen keyboard"

IMAGE_FSTYPES = "ext4 iso"
```
